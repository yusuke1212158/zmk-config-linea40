/ {
    combos {
        compatible = "zmk,combos";

        /* 1つ目のコンボ（スクロール） */
        combo_scroll: scroll_layer {
            timeout-ms = <50>;
            key-positions = <16 17>;
            bindings = <&mo 9>;
        };

        /* 2つ目のコンボ（BT/Bluetooth設定用） */
        combo_bt: bt_layer {
            timeout-ms = <50>;
            key-positions = <34 35>;
            bindings = <&mo 10>;
        };
    };
};
