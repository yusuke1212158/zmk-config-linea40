#include "LiNEA40.dtsi"
#include <input/processors.dtsi>
#include <input/processors/runtime-input-processor.dtsi>
#include <behaviors/battery_history_request.dtsi>

/* ===============================
 * Matrix
 * =============================== */
&kscan0 {
    col-gpios
        = <&xiao_d 10 GPIO_ACTIVE_HIGH> // col0
        , <&xiao_d 9  GPIO_ACTIVE_HIGH> // col1
        , <&xiao_d 8  GPIO_ACTIVE_HIGH> // col2
        , <&xiao_d 7  GPIO_ACTIVE_HIGH> // col3
        , <&gpio0 10 GPIO_ACTIVE_HIGH>  // col4 NFC2
        , <&gpio0 9  GPIO_ACTIVE_HIGH>  // col5 NFC1
        ;
};

/* ===============================
 * SPI (Trackball)
 * =============================== */
&pinctrl {
    spi0_default: spi0_default {
        group1 {
            psels = <NRF_PSEL(SPIM_SCK,  0, 5)>,
                    <NRF_PSEL(SPIM_MOSI, 0, 4)>,
                    <NRF_PSEL(SPIM_MISO, 0, 4)>;
        };
    };

    spi0_sleep: spi0_sleep {
        group1 {
            psels = <NRF_PSEL(SPIM_SCK,  0, 5)>,
                    <NRF_PSEL(SPIM_MOSI, 0, 4)>,
                    <NRF_PSEL(SPIM_MISO, 0, 4)>;
            low-power-enable;
        };
    };
};

&spi0 {
    status = "okay";
    compatible = "nordic,nrf-spim";
    pinctrl-0 = <&spi0_default>;
    pinctrl-1 = <&spi0_sleep>;
    pinctrl-names = "default", "sleep";
    cs-gpios = <&gpio0 9 GPIO_ACTIVE_LOW>;

    trackball: trackball@0 {
        status = "okay";
        compatible = "pixart,pmw3610";
        reg = <0>;
        spi-max-frequency = <2000000>;
        irq-gpios = <&xiao_d 6 (GPIO_ACTIVE_LOW | GPIO_PULL_UP)>;
        automouse-layer = <2>;
    };
};

/* ===============================
 * Encoder
 * =============================== */
&left_encoder {
    status = "okay";
};

/* ===============================
 * AML 誤爆防止（J+K）
 * =============================== */
&zip_temp_layer {
    excluded-positions = <
        16 /* J */
        17 /* K */
    >;
    require-prior-idle-ms = <400>;
};

/* ===============================
 * Input processors
 * =============================== */
 / {
    /* ---- Encoder scroll processors ---- */

    /* 通常：ナチュラル（右回り＝下） */
    encoder_scroll_natural: encoder_scroll_natural {
        compatible = "zmk,scroll-runtime-input-processor";
        invert-y;
    };

    /* Layer9：非ナチュラル */
    encoder_scroll_unnatural: encoder_scroll_unnatural {
        compatible = "zmk,scroll-runtime-input-processor";
    };

    /* ===============================
     * Trackball listener
     * =============================== */
    trackball_listener {
        status = "okay";
        compatible = "zmk,input-listener";
        device = <&trackball>;

        /* トラボの XY のみ */
        input-sources = <INPUT_REL_X INPUT_REL_Y>;

        /* 通常：マウス */
        input-processors = <&mouse_runtime_input_processor>;

        /* Layer 9：スクロール */
        scroller {
            layers = <9>;
            input-processors =
                <&zip_xy_to_scroll_mapper
                 &scroll_runtime_input_processor>;
        };
    };

    /* ===============================
     * Left encoder listener
     * =============================== */
    left_encoder_listener {
        status = "okay";
        compatible = "zmk,input-listener";
        device = <&left_encoder>;

        /* EC11 */
        input-sources = <INPUT_REL_DIAL>;

        /* 通常：ナチュラルスクロール */
        input-processors = <&encoder_scroll_natural>;

        /* Layer 9：非ナチュラルスクロール */
        unnatural {
            layers = <9>;
            input-processors = <&encoder_scroll_unnatural>;
        };
    };
};
};