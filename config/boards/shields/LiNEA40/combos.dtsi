/ {
    combos {
        compatible = "zmk,combos";

        combo_scroll: scroll_layer {
            timeout-ms = <50>;
            key-positions = <16 17>; // JとKの正しい位置を指定
            bindings = <&mo 9>;
        };
    };
};
